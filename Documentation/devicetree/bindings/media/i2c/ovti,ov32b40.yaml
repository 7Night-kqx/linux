## Documentation/devicetree/bindings/media/i2c/ovti,ov32b40.yaml
```yaml
# SPDX-License-Identifier: (GPL-2.0-only OR BSD-2-Clause)
%YAML 1.2
---
$id: http://devicetree.org/schemas/media/i2c/ovti,ov32b40.yaml#
$schema: http://devicetree.org/meta-schemas/core.yaml#

title: OmniVision OV32B40 image sensor

maintainers:
  - 7Night-kqx <7Night-kqx@users.noreply.github.com>

description: |
  32 megapixel image sensor with a MIPI CSI-2 D-PHY interface. The initial
  driver implements the fixed 6528x4896 RAW10 mode with a 19.2 MHz clock.

allOf:
  - $ref: /schemas/media/video-interface-devices.yaml#

properties:
  compatible:
    const: ovti,ov32b40
  reg:
    maxItems: 1
  clocks:
    maxItems: 1
  power-domains:
    maxItems: 1
    description: Camera interface power domain required by the sensor clock.
  avdd-supply:
    description: Analogue supply, 2.8 V.
  dovdd-supply:
    description: Digital I/O supply, 1.8 V.
  dvdd-supply:
    description: Digital core supply, 1.104 V on Xiaomi dada.
  reset-gpios:
    maxItems: 1
    description: Active low reset.
  port:
    $ref: /schemas/graph.yaml#/$defs/port-base
    unevaluatedProperties: false
    properties:
      endpoint:
        $ref: /schemas/media/video-interfaces.yaml#
        unevaluatedProperties: false
        properties:
          bus-type:
            const: 4
          data-lanes:
            items:
              - const: 1
              - const: 2
              - const: 3
              - const: 4
          link-frequencies:
            items:
              - const: 842400000
        required:
          - data-lanes
          - link-frequencies

required:
  - compatible
  - reg
  - clocks
  - avdd-supply
  - dovdd-supply
  - dvdd-supply
  - reset-gpios
  - port

unevaluatedProperties: false

examples:
  - |
    #include <dt-bindings/gpio/gpio.h>
    i2c {
        #address-cells = <1>;
        #size-cells = <0>;
        camera@10 {
            compatible = "ovti,ov32b40";
            reg = <0x10>;
            clocks = <&camclk>;
            avdd-supply = <&avdd>;
            dovdd-supply = <&dovdd>;
            dvdd-supply = <&dvdd>;
            reset-gpios = <&gpio 7 GPIO_ACTIVE_LOW>;
            port {
                endpoint {
                    bus-type = <4>;
                    data-lanes = <1 2 3 4>;
                    link-frequencies = /bits/ 64 <842400000>;
                };
            };
        };
    };
```

## Documentation/devicetree/bindings/media/i2c/ovti,ovx9100.yaml
```yaml
# SPDX-License-Identifier: (GPL-2.0-only OR BSD-2-Clause)
%YAML 1.2
---
$id: http://devicetree.org/schemas/media/i2c/ovti,ovx9100.yaml#
$schema: http://devicetree.org/meta-schemas/core.yaml#

title: OmniVision OVX9100 camera sensor

maintainers:
  - 7Night-kqx <7Night-kqx@users.noreply.github.com>

description: |
  OVX9100 is the Xiaomi dada main camera sensor. The current experimental
  implementation probes the sensor and contains a fixed RAW10 mode. C-PHY
  characterization, module identification, autofocus and OIS are separate
  bring-up requirements. Sensor nodes must remain disabled until these
  requirements are established for the phone under test.

allOf:
  - $ref: /schemas/media/video-interface-devices.yaml#

properties:
  compatible:
    const: ovti,ovx9100

  reg:
    maxItems: 1

  clocks:
    maxItems: 1

  clock-names:
    const: xclk

  clock-frequency:
    const: 19200000

  power-domains:
    maxItems: 1

  reset-gpios:
    maxItems: 1

  bob-supply:
    description: Upstream BOB2 supply requested at 3.296 V during operation.

  vaf-supply:
    description: Lens supply requested at 3.304 V during operation.

  avdd-supply:
    description: Analogue sensor supply requested at 2.9 V.

  dovdd-supply:
    description: Sensor I/O supply requested at 1.8 V.

  dvdd-supply:
    description: Sensor digital supply requested at 1.2 V.

  port:
    $ref: /schemas/graph.yaml#/$defs/port-base
    unevaluatedProperties: false

    properties:
      endpoint:
        $ref: /schemas/media/video-interfaces.yaml#
        unevaluatedProperties: false

        properties:
          bus-type:
            const: 1

          data-lanes:
            items:
              - const: 0
              - const: 1
              - const: 2

          line-orders:
            items:
              - const: 0
              - const: 0
              - const: 0

        required:
          - bus-type
          - data-lanes

required:
  - compatible
  - reg
  - clocks
  - reset-gpios
  - bob-supply
  - vaf-supply
  - avdd-supply
  - dovdd-supply
  - dvdd-supply
  - port

unevaluatedProperties: false
```

## Documentation/devicetree/bindings/media/i2c/xiaomi,dada-vcm.yaml
```yaml
# SPDX-License-Identifier: (GPL-2.0-only OR BSD-2-Clause)
%YAML 1.2
---
$id: http://devicetree.org/schemas/media/i2c/xiaomi,dada-vcm.yaml#
$schema: http://devicetree.org/meta-schemas/core.yaml#

title: Xiaomi dada experimental camera lens actuators

maintainers:
  - 7Night-kqx <7Night-kqx@users.noreply.github.com>

description: |
  Module-specific experimental AK7316 and GT9764V focus support. The linked
  camera sensor owns shared regulators, reset and MCLK. Runtime PM keeps that
  sensor powered while the lens is accessed. EEPROM calibration and
  gravity-dependent AK7316 parking are not implemented.

properties:
  compatible:
    enum:
      - xiaomi,dada-ak7316
      - xiaomi,dada-gt9764v

  reg:
    const: 0x0c

  xiaomi,power-sensor:
    $ref: /schemas/types.yaml#/definitions/phandle
    description: Camera sensor controlling the shared module power sequence.

required:
  - compatible
  - reg
  - xiaomi,power-sensor

additionalProperties: false
```

## Documentation/devicetree/bindings/net/nfc/st,st54l.yaml
```yaml
# SPDX-License-Identifier: (GPL-2.0-only OR BSD-2-Clause)
%YAML 1.2
---
$id: http://devicetree.org/schemas/net/nfc/st,st54l.yaml#
$schema: http://devicetree.org/meta-schemas/core.yaml#

title: STMicroelectronics ST54L raw NCI NFC controller

maintainers:
  - 7Night-kqx <7Night-kqx@users.noreply.github.com>

description: |
  ST54L uses raw NCI over I2C, without NDLC framing. Firmware and board RF
  calibration are stored on the controller. CLKREQ is a hardware clock
  request input to the host and needs routing to the platform clock logic.

properties:
  compatible:
    const: st,st54l

  reg:
    maxItems: 1

  reset-gpios:
    maxItems: 1
    description: Controller reset line; high deasserts reset (reset-enable convention).

  irq-gpios:
    maxItems: 1
    description: Active-high controller data-ready signal.

  clkreq-gpios:
    maxItems: 1
    description: Active-high hardware clock request from the controller.

required:
  - compatible
  - reg
  - reset-gpios
  - irq-gpios
  - clkreq-gpios

additionalProperties: false

examples:
  - |
    #include <dt-bindings/gpio/gpio.h>
    i2c {
        #address-cells = <1>;
        #size-cells = <0>;
        nfc@8 {
            compatible = "st,st54l";
            reg = <0x08>;
            reset-gpios = <&gpio 34 GPIO_ACTIVE_HIGH>;
            irq-gpios = <&gpio 75 GPIO_ACTIVE_HIGH>;
            clkreq-gpios = <&gpio 35 GPIO_ACTIVE_HIGH>;
        };
    };
```

## drivers/power/supply/mca/Kconfig
```kconfig
config XM_POWER_SUPPLY
	tristate "Xiaomi MCA power supply framework"
	depends on OF_GPIO && GPIOLIB_LEGACY
	help
	  Xiaomi Multi Charge Architecture (MCA) power-supply framework.

if XM_POWER_SUPPLY

config MCA_DADA_KERNEL_AUTH
	bool "Xiaomi dada automatic battery authentication"
	depends on XM_POWER_SUPPLY=y && MCA_EXTERNAL_FG=y
	select CRYPTO_LIB_SHA256
	select CRYPTO_LIB_UTILS
	help
	  Verify two fresh HMAC-SHA256 gauge challenges asynchronously after
	  the charging framework is ready. Matching profile data must be
	  generated at build time. Errors retain unauthenticated limits.
	  No userspace authentication service is required.

# Protocol layer
config MCA_PROTOCOL_PD
	tristate "MCA USB Power Delivery protocol support"

config MCA_PROTOCOL_QC
	tristate "MCA Qualcomm QuickCharge protocol support"

# External hardware IC drivers
config MCA_EXTERNAL_FG
	tristate "MCA external fuel gauge IC support"

config MCA_EXTERNAL_CP
	tristate "MCA external charge pump IC support"

config MCA_EXTERNAL_CP_SC8541
	tristate "MCA SC8541 charge pump IC support"

config MCA_EXTERNAL_WIRELESS
	tristate "MCA external wireless charging IC support"

config MCA_EXTERNAL_WIRELESS_SC96281
	tristate "MCA SC96281 wireless charging IC support"

config MCA_EXTERNAL_LOADSWITCH
	tristate "MCA external load switch IC support"

config MCA_EXTERNAL_BOOST
	tristate "MCA external boost IC support"

# Qualcomm platform glue
config MCA_QCOM_SUBPMIC
	tristate "MCA Qualcomm sub-PMIC proxy support"

config MCA_QCOM_ADSP
	tristate "MCA Qualcomm ADSP glink support"
	depends on QCOM_PMIC_GLINK && !BATTERY_QCOM_BATTMGR
	select AUXILIARY_BUS

config MCA_QCOM_SYSFS
	tristate "MCA Qualcomm sysfs support"

config MCA_QCOM_SMEM
	tristate "MCA Qualcomm shared memory support"

config MCA_QCOM_PANEL
	tristate "MCA Qualcomm panel notifier support"

# Shared memory
config CHARGER_PARTITION
	tristate "MCA charger partition (shared-memory charging state)"
	default XM_POWER_SUPPLY
	help
	  Shared-memory charging state exchanged between LK/UEFI/ABL/ADSP,
	  the kernel and the charging HAL. Core MCA component referenced
	  unconditionally by the business/strategy layers; keep enabled with
	  the framework.

# Test
config MCA_UT_TEST
	tristate "MCA unit test module"

endif # XM_POWER_SUPPLY
```
